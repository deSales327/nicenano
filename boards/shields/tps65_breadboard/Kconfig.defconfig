## boards/shields/tps65_breadboard/Kconfig.defconfig
```kconfig
if SHIELD_TPS65_BREADBOARD

config ZMK_KEYBOARD_NAME
    default "TPS65 Breadboard"

config ZMK_POINTING
    default y

config I2C
    default y

endif
```

## boards/shields/tps65_breadboard/Kconfig.shield
```kconfig
config SHIELD_TPS65_BREADBOARD
    def_bool $(shields_list_contains,tps65_breadboard)
```

## boards/shields/tps65_central/Kconfig.defconfig
```kconfig
if SHIELD_TPS65_CENTRAL

config ZMK_POINTING
    default y

config I2C
    default y

endif
```

## boards/shields/tps65_listener/Kconfig.defconfig
```kconfig
if SHIELD_TPS65_LISTENER

config ZMK_POINTING
    default y

config I2C
    default y

endif
```

## boards/shields/tps65_listener/Kconfig.shield
```kconfig
config SHIELD_TPS65_LISTENER
    def_bool $(shields_list_contains,tps65_listener)
```

## boards/shields/tps65_peripheral/Kconfig.defconfig
```kconfig
if SHIELD_TPS65_PERIPHERAL

config ZMK_POINTING
    default y

config I2C
    default y

endif
```

## boards/shields/tps65_peripheral/Kconfig.shield
```kconfig
config SHIELD_TPS65_PERIPHERAL
    def_bool $(shields_list_contains,tps65_peripheral)
```

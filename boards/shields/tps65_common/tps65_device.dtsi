#include <dt-bindings/gpio/gpio.h>

&pro_micro_i2c {
    status = "okay";
    clock-frequency = <400000>;

    tps65: trackpad@74 {
        compatible = "azoteq,iqs5xx";
        reg = <0x74>;
        status = "okay";
        rdy-gpios = <&pro_micro 8 GPIO_ACTIVE_HIGH>;
        reset-gpios = <&pro_micro 9 GPIO_ACTIVE_LOW>;
        one-finger-tap;
        press-and-hold;
        press-and-hold-time = <250>;
        two-finger-tap;
        scroll;
        bottom-beta = <5>;
        stationary-threshold = <5>;
    };
};
